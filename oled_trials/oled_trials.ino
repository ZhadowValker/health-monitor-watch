#include <Wire.h>
#include <Adafruit_GFX.h>
#include <Adafruit_SSD1306.h>
#include <ESP8266WiFi.h>
#include <PubSubClient.h>
#include <BlynkSimpleEsp8266.h>

#define SCREEN_WIDTH 128
#define SCREEN_HEIGHT 64
#define BLYNK_PRINT Serial

char auth[] = "rP3GaX8cfZg8S-328aNV6dWvJo82gvnx";

// Your WiFi credentials.
// Set password to "" for open networks.
//char ssid[] = "Zeptogreens";
//char pass[] = "Zeptogreens20";
//

const char* ssid = "wifi 2.4";
const char* password = "m4n1f3s7";
//const char* mqtt_server = "192.168.0.117";

//const char* ssid = "Zeptogreens";
//const char* password = "Zeptogreens20";
//const char* mqtt_server = "192.168.0.171";


//const char* ssid = "Cenaura";
//const char* password = "Centech@2020";
//const char* mqtt_server = "192.168.0.171";

BlynkTimer timer;
WidgetTerminal terminal(V1);

WiFiClient espClient;
PubSubClient client(espClient);
unsigned long lastMsg = 0;
#define MSG_BUFFER_SIZE  (50)
char msg[MSG_BUFFER_SIZE];
int value = 0;
double thermistor=0;

Adafruit_SSD1306 display(SCREEN_WIDTH, SCREEN_HEIGHT, &Wire, -1);

static const uint8_t image_data_orinci[768] = {
   
    0x00, 0x00, 0x00, 0x00, 0x00, 0x00, 0x00, 0x00, 0x00, 0x00, 0x00, 0x00, 
    0x00, 0x00, 0x00, 0x00, 0x00, 0x3f, 0xc0, 0x00, 0x00, 0x00, 0x00, 0x00, 
    0x00, 0x00, 0x00, 0x00, 0x07, 0xff, 0xfc, 0x00, 0x00, 0x00, 0x00, 0x00, 
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    0x00, 0x00, 0x00, 0x00, 0x00, 0x00, 0x00, 0x00, 0x00, 0x00, 0x00, 0x00
};

static const uint8_t image_data_thermometer[82] = {
    0x01, 0x80, 
    0x03, 0xc0, 
    0x06, 0x60, 
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    0x03, 0xc0
};


int bootup=0;
 
void setup() 
{
  Serial.begin(115200);
  if(!display.begin(SSD1306_SWITCHCAPVCC, 0x3C)) 
	{
    Serial.println(F("SSD1306 allocation failed"));
    for(;;);
	}	
  display.clearDisplay();
//  setup_wifi();
//  Blynk.begin(auth, ssid, password);
//  WiFiClient espClient;
//  client.setServer(mqtt_server, 1883);
  delay(2000);
  display.clearDisplay();
//   timer.setInterval(1000L, myTimerEvent);
logo();
boot();
}
 
  
void loop(){
 bootup=1;
 double adc,k,c,f;
 temp(adc,k,c,f);
 thermistor=f;
  timer.run(); 
  Blynk.run();
 client.publish("/esp", "mkiujnbhyujhjk", true);

display.clearDisplay();
display.setTextSize(1);
display.setTextColor(WHITE,BLACK);
display.setCursor(4,0);
display.println(" ORINCI LABS PVT LTD");
display.drawBitmap(0, 10, image_data_thermometer, 16,41 , 1);

display.setTextColor(WHITE, BLACK); 
display.setTextSize(2);
display.setCursor(18,20);
display.print(f);
display.println(" F");
display.setCursor(18,36);
display.print(c);
display.println(" C");

display.setTextSize(1);
//display.print(WiFi.macAddress());
display.setCursor(0,57);
//display.print(WiFi.localIP());
display.display();
delay(2000);
}



void logo()
{
  display.clearDisplay();
  display.drawBitmap(20, 0, image_data_orinci, 89, 64, 1);
  display.setTextSize(1);
  display.setTextColor(WHITE,BLACK);
  display.setCursor(0,55);
  display.println(" ORINCI LABS PVT LTD");
  display.display();
  delay(5000);  
  display.clearDisplay();
}

void boot()
{

  {
  display.clearDisplay();
  display.drawPixel(10, 10, SSD1306_WHITE);
  display.display();
  delay(500);

  display.clearDisplay();
  display.display();
  delay(500);
  
  display.clearDisplay();
  display.drawPixel(10, 10, SSD1306_WHITE);
  display.display();
  delay(500);
  
  display.clearDisplay();
  display.display();
  delay(500);

  }
}

void temp(double &adc_value,double &k,double &c,double &f)
{
  double Vout, Rth; 
  const double VCC = 3.3;             // NodeMCU on board 3.3v vcc
  const double R2 = 10000;            // 10k ohm series resistor
  const double adc_resolution = 1024; // 10-bit adc
  const double A = 0.001129148;       // thermistor equation parameters
  const double B = 0.000234125;
  const double C = 0.0000000876741; 
  
  adc_value = analogRead(A0);
  //Vout = analogRead(A0) * (VCC / adc_resolution); 
  Vout = (adc_value * VCC) / adc_resolution;
  Rth = (VCC * R2 / Vout) - R2;

/*  Steinhart-Hart Thermistor Equation:
 *  Temperature in Kelvin = 1 / (A + B[ln(R)] + C[ln(R)]^3)
 *  where A = 0.001129148, B = 0.000234125 and C = 8.76741*10^-8  */
  
  k = (1 / (A + (B * log(Rth)) + (C * pow((log(Rth)),3))));   // Temperature in kelvin
  c = k - 273.15;  // Temperature in degree celsius
  f = (c * 9/5) +32; //  Temperature in degree celsius fahrenheit | (0°C × 9/5) + 32 = 32°F

  delay(1000);
 }  

void setup_wifi() 
{
  delay(10);
  // We start by connecting to a WiFi network
  Serial.println();
  Serial.print("Connecting to ");
  Serial.println(ssid);

  WiFi.mode(WIFI_STA);
  WiFi.begin(ssid, password);
  

  while (WiFi.status() != WL_CONNECTED) 
  {
    delay(500);
    Serial.print(".");
  }

  randomSeed(micros());

  Serial.println("");
  Serial.println("WiFi connected");
  Serial.println("IP address: ");
  Serial.println(WiFi.localIP());
  timer.setInterval(1000L, myTimerEvent);
}

void reconnect()
{
    // Loop until we're reconnected
    while (!client.connected()) 
	{
        Serial.print("Attempting MQTT connection...");
        if (client.connect("nodeMcuDHT11")) 
		{
            Serial.println("connected");
        } 
		else 
		{
            Serial.print("failed, rc=");
            Serial.print(client.state());
            Serial.println(" try again in 5 seconds");
            delay(5000);
        }
    }
}




void myTimerEvent()
{
  // You can send any value at any time.
  // Please don't send more that 10 values per second.
 Blynk.virtualWrite(V0, thermistor);
}
